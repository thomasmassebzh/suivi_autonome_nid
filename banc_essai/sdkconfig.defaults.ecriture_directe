## firmware/components/nid_storage/Kconfig
```kconfig
menu "Suivi nid — Stockage"

    choice NID_STORAGE_MEDIUM
        prompt "Support des vidéos, photos et du journal"
        default NID_STORAGE_SD
        help
            Le support est monté sous /sdcard dans tous les cas (config.ini,
            dossiers <SYS>_<NID>, journal.csv) ; formaté en FAT32, jamais
            reformaté par le firmware.

        config NID_STORAGE_SD
            bool "Carte microSD"
        config NID_STORAGE_USB
            bool "Clé ou disque USB (hôte USB 2.0 de l'ESP32-P4)"
            help
                Clé, carte SD dans un lecteur USB, ou disque SSD USB, au bout
                d'un câble USB 2.0 de 5 m au plus (clé et batterie au pied de
                l'arbre). Prévoir un interrupteur sur le 5 V USB (broche
                « interrupteur du 5 V USB » du menu « Carte et brochage ») :
                une clé consomme 20 à 100 mA au repos.
        config NID_STORAGE_AUTO
            bool "Clé USB si elle est branchée, sinon carte microSD"
            help
                Chaque montage commence par chercher une clé USB (au plus le
                délai ci-dessous) : à réserver au banc d'essai, le délai
                s'ajoute au temps de réaction du terrain.
    endchoice

    config NID_USB_CONNECT_TIMEOUT_MS
        int "Délai maximal de détection de la clé USB (ms)"
        depends on NID_STORAGE_USB || NID_STORAGE_AUTO
        range 300 20000
        default 1500 if NID_STORAGE_AUTO
        default 5000
        help
            Temps laissé à la clé pour démarrer et s'énumérer après la mise
            sous tension du 5 V USB (une clé courante répond en 0,3 à 1 s,
            certains disques en plus de 2 s).

endmenu
```

## firmware/components/nid_writer/Kconfig
```kconfig
menu "Suivi nid — Écriture asynchrone (vidéo)"

    config NID_WRITER_BUFFER_KB
        int "Taille du tampon d'écriture en PSRAM (ko)"
        range 256 16384
        default 4096
        help
            Les données vidéo passent par ce tampon avant d'être écrites sur la
            carte SD ou la clé USB par une tâche dédiée : la caméra n'attend plus
            le support. 4096 ko ≈ 13 s de vidéo à 2,5 Mbit/s, ≈ 8 s à 4 Mbit/s ;
            de quoi absorber les pauses d'une carte SD (nettoyage interne) et le
            montage d'une clé USB. Le tampon n'est alloué que pendant un
            enregistrement.

    config NID_WRITER_STALL_TIMEOUT_MS
        int "Attente maximale quand le tampon est plein (ms)"
        range 500 60000
        default 3000
        help
            Au-delà, la séquence est arrêtée (fichier fermé proprement) : le
            support est plein, retiré ou durablement trop lent.

    config NID_WRITER_TASK_PRIO
        int "Priorité de la tâche d'écriture"
        range 1 20
        default 4

    config NID_WRITER_TASK_CORE
        int "Cœur de la tâche d'écriture (-1 = indifférent)"
        range -1 1
        default 1
        help
            Cœur 1 par défaut : la boucle caméra → encodeur tourne sur le cœur 0
            (tâche principale).

endmenu
```
