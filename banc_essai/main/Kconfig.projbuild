## firmware/components/nid_board/Kconfig
```kconfig
menu "Suivi nid — Carte et brochage"

    comment "Valeurs par défaut : ESP32-P4X-Function-EV-Board (connecteur J1). -1 = non câblé."

    config NID_PIN_PIR
        int "GPIO sortie du détecteur PIR (LP GPIO 0-15, réveil de veille profonde)"
        range 0 15
        default 4
        help
            Sortie du HC-SR501 (ou du PIR Panasonic EKMB). Doit être une broche
            basse consommation (GPIO 0 à 15) pour réveiller l'ESP32-P4 par EXT1.
            À éviter sur la P4X : GPIO 0-1 (quartz 32 kHz), 7-8 (I2C).

    config NID_PIR_ACTIVE_HIGH
        bool "Sortie PIR active à l'état haut"
        default y

    config NID_PIN_BUTTON
        int "GPIO bouton de mise en service (LP GPIO 0-15, actif bas ; -1 = aucun)"
        range -1 15
        default 5
        help
            Bouton vers la masse (pull-up interne). Un appui réveille le système
            et ouvre le mode installation (Wi-Fi + aperçu).

    config NID_PIN_RTC_INT
        int "GPIO sortie INT/SQW du DS3231 (LP GPIO 0-15 ; -1 = non câblée)"
        range -1 15
        default -1
        help
            Optionnel en veille profonde (le réveil minuterie de l'ESP32-P4 suffit).
            Dans l'architecture « coupure matérielle », la sortie INT commande
            l'interrupteur d'alimentation et n'a pas besoin d'être reliée ici.

    config NID_PIN_STATUS_LED
        int "GPIO voyant d'état (allumé uniquement en installation ; -1 = aucun)"
        range -1 54
        default 46

    config NID_STATUS_LED_ACTIVE_HIGH
        bool "Voyant d'état actif à l'état haut"
        default y

    config NID_PIN_IR_LED
        int "GPIO commande du MOSFET des LED IR 940 nm (-1 = aucune)"
        range -1 54
        default 32

    config NID_IR_LED_PWM_FREQ_HZ
        int "Fréquence PWM des LED IR (Hz)"
        range 100 40000
        default 20000
        help
            20 kHz : inaudible (FC1.2) et sans scintillement visible par la caméra.

    choice NID_IRCUT_DRIVE
        prompt "Commande du filtre IR-cut"
        default NID_IRCUT_NONE
        help
            Dépend du module caméra (point ouvert pour la caméra Waveshare RPi
            IR-CUT : photorésistance seule ou broche de commande). Si le filtre
            bascule seul, choisir « aucune ».

        config NID_IRCUT_NONE
            bool "Aucune (filtre automatique du module, ou pas de filtre)"
        config NID_IRCUT_LEVEL
            bool "Un fil : niveau logique permanent"
        config NID_IRCUT_PULSE
            bool "Deux fils : impulsion via pont en H (filtre bistable)"
    endchoice

    config NID_PIN_IRCUT_A
        int "GPIO IR-cut A (ou fil unique)"
        range -1 54
        default 33
        depends on !NID_IRCUT_NONE

    config NID_PIN_IRCUT_B
        int "GPIO IR-cut B (pont en H)"
        range -1 54
        default 36
        depends on NID_IRCUT_PULSE

    config NID_IRCUT_DAY_LEVEL
        int "Niveau du fil IR-cut pour le mode jour (filtre en place)"
        range 0 1
        default 1
        depends on NID_IRCUT_LEVEL

    config NID_IRCUT_PULSE_MS
        int "Durée de l'impulsion IR-cut (ms)"
        range 20 1000
        default 150
        depends on NID_IRCUT_PULSE

    config NID_PIN_BATT_ADC
        int "GPIO mesure de la tension batterie (ADC1 : 16-23, ADC2 : 49-54 ; -1 = aucune)"
        range -1 54
        default 21
        help
            Pont diviseur depuis la batterie (ex. 100 kΩ / 100 kΩ). Sans mesure,
            l'arrêt propre sur seuil bas (FC3.4) n'est pas assuré par le logiciel.

    config NID_BATT_DIVIDER_X1000
        int "Rapport du pont diviseur × 1000 (Vbat = Vadc × rapport / 1000)"
        range 1000 20000
        default 2000

    config NID_PIN_LDR_ADC
        int "GPIO photorésistance optionnelle (ADC ; -1 = aucune)"
        range -1 54
        default -1

    config NID_PIN_POWER_OFF
        int "GPIO commande OFF de l'interrupteur d'alimentation Pololu (-1 = aucune)"
        range -1 54
        default 47
        help
            Utilisé seulement dans l'architecture « coupure matérielle » : un niveau
            haut sur OFF coupe l'alimentation de la carte en fin de cycle.

    config NID_I2C_PORT
        int "Port I2C partagé (caméra, codec audio, horloge DS3231)"
        range 0 1
        default 0

    config NID_PIN_I2C_SDA
        int "GPIO I2C SDA"
        range 0 54
        default 7

    config NID_PIN_I2C_SCL
        int "GPIO I2C SCL"
        range 0 54
        default 8

    config NID_I2C_FREQ_HZ
        int "Fréquence I2C (Hz)"
        range 10000 400000
        default 100000

    config NID_PIN_C6_RESET
        int "GPIO reset du coprocesseur Wi-Fi ESP32-C6 (-1 = aucun)"
        range -1 54
        default 54
        help
            Le C6 est maintenu en reset hors mode installation pour économiser
            l'énergie (FC3.2).

    config NID_PIN_LCD_BACKLIGHT
        int "GPIO rétroéclairage LCD, maintenu éteint (-1 = aucun)"
        range -1 54
        default 26

    config NID_PIN_AUDIO_PA
        int "GPIO activation de l'ampli audio NS4150B, maintenu coupé (-1 = aucun)"
        range -1 54
        default 53

    config NID_PIN_CAM_RESET
        int "GPIO reset du capteur caméra (-1 = aucun)"
        range -1 54
        default -1

    config NID_PIN_CAM_PWDN
        int "GPIO power-down du capteur caméra (-1 = aucun)"
        range -1 54
        default -1

    menu "Audio (codec ES8311)"
        config NID_PIN_I2S_MCLK
            int "I2S MCLK"
            default 13
        config NID_PIN_I2S_BCLK
            int "I2S BCLK"
            default 12
        config NID_PIN_I2S_WS
            int "I2S WS (LRCK)"
            default 10
        config NID_PIN_I2S_DOUT
            int "I2S DOUT (vers le codec)"
            default 9
        config NID_PIN_I2S_DIN
            int "I2S DIN (depuis le micro)"
            default 11
        config NID_ES8311_I2C_ADDR
            hex "Adresse I2C de l'ES8311 (8 bits)"
            default 0x30
    endmenu

    menu "Carte microSD (SDMMC)"
        config NID_SD_BUS_WIDTH
            int "Largeur du bus SD (1 ou 4)"
            range 1 4
            default 4
        config NID_SD_FREQ_KHZ
            int "Fréquence SD (kHz)"
            range 400 50000
            default 40000
        config NID_SD_LDO_CHAN
            int "Canal du LDO interne alimentant la carte SD (-1 = aucun)"
            range -1 4
            default 4
            help
                Sur ESP32-P4, l'alimentation de la carte SD passe par le LDO
                interne canal 4 (VO4) sur la P4X-Function-EV-Board.
        config NID_PIN_SD_CLK
            int "SD CLK"
            default 43
        config NID_PIN_SD_CMD
            int "SD CMD"
            default 44
        config NID_PIN_SD_D0
            int "SD D0"
            default 39
        config NID_PIN_SD_D1
            int "SD D1"
            default 40
        config NID_PIN_SD_D2
            int "SD D2"
            default 41
        config NID_PIN_SD_D3
            int "SD D3"
            default 42
    endmenu

endmenu
```

## firmware/components/nid_clock/Kconfig
```kconfig
menu "Suivi nid — Horloge temps réel"

    choice NID_RTC_MODEL
        prompt "Horloge temps réel externe"
        default NID_RTC_AUTO
        help
            DS3231 recommandé (3,3 V, ±2 ppm, alarme, température) : dérive
            ≤ 1 min sur 14 jours (FP1.6). Le module DS1307 de l'inventaire
            fonctionne en 5 V : ne pas relier ses résistances de tirage I2C à
            5 V sur les broches de l'ESP32-P4.

        config NID_RTC_AUTO
            bool "Détection automatique (DS3231, sinon DS1307)"
        config NID_RTC_DS3231
            bool "DS3231"
        config NID_RTC_DS1307
            bool "DS1307"
        config NID_RTC_NONE
            bool "Aucune (horloge interne uniquement, heure réglée depuis le smartphone)"
    endchoice

    config NID_RTC_I2C_ADDR
        hex "Adresse I2C (7 bits)"
        default 0x68

endmenu
```

## firmware/components/nid_install/Kconfig
```kconfig
menu "Suivi nid — Mode installation"

    config NID_INSTALL_WIFI_CHANNEL
        int "Canal du point d'accès Wi-Fi d'installation"
        range 1 13
        default 6

    config NID_INSTALL_WIFI_MAX_CLIENTS
        int "Nombre maximal de téléphones connectés"
        range 1 4
        default 2

    config NID_INSTALL_WIFI_START_TIMEOUT_S
        int "Délai maximal de démarrage du Wi-Fi (s)"
        range 5 60
        default 15
        help
            Garde-fou global : si le point d'accès n'est pas prêt dans ce délai,
            le mode installation continue sans Wi-Fi (voyant : double éclat
            toutes les 2 s ; appui court = démarrer, appui long = maintenance).
            Un ESP32-C6 qui ne répond pas est normalement détecté plus tôt par
            ESP-Hosted (reset 1,5 s + énumération SDIO 1,5 s +
            CONFIG_ESP_HOSTED_HOST_CP_BRINGUP_TIMEOUT_MS).

    config NID_INSTALL_PREVIEW_MAX_WIDTH
        int "Largeur maximale de l'aperçu (pixels)"
        range 320 1920
        default 640

    config NID_INSTALL_PREVIEW_QUALITY
        int "Qualité JPEG de l'aperçu"
        range 10 100
        default 60

    config NID_INSTALL_PREVIEW_MAX_FPS
        int "Cadence maximale de l'aperçu (images/s)"
        range 1 30
        default 8

    config NID_INSTALL_HTTPD_STACK_SIZE
        int "Pile de la tâche du serveur web (octets)"
        range 4096 16384
        default 8192
        help
            Les gestionnaires appellent nid_config_save(), nid_capture_photo()
            et nid_clock_set_time() depuis la tâche du serveur web.

    config NID_INSTALL_HTTPD_MAX_URI_HANDLERS
        int "Nombre maximal de gestionnaires d'URI du serveur web"
        range 11 32
        default 16

endmenu
```

## firmware/components/nid_power/Kconfig
```kconfig
menu "Suivi nid — Énergie et veille"

    config NID_BATT_SAMPLES
        int "Échantillons ADC par mesure de la batterie"
        range 4 64
        default 16
        help
            Moyenne tronquée (les 1/8 plus bas et plus hauts sont écartés) :
            rejette les creux de tension dus aux appels de courant (caméra,
            LED IR). Une mesure de 16 échantillons dure moins d'une milliseconde.

    config NID_BUTTON_RELEASE_WAIT_MS
        int "Attente du relâchement du bouton avant la veille (ms)"
        range 0 10000
        default 3000
        help
            Le réveil par le bouton se fait sur niveau bas : un bouton encore
            appuyé réveillerait aussitôt le système. Si le bouton reste appuyé
            plus longtemps (bouton bloqué, infiltration d'eau), il n'est pas
            utilisé comme source de réveil pour cette veille-là.

    config NID_SLEEP_SILENT_ROM
        bool "Supprimer les messages de la ROM au réveil (démarrage plus rapide)"
        default y
        help
            Gagne environ 20 à 30 ms par réveil sur la console série à
            115200 bauds (FP1.4 : délai détection → première image). Les
            messages de la ROM restent supprimés après un redémarrage sur défaut ;
            ils réapparaissent après une coupure d'alimentation.

    config NID_SLEEP_LDO_OFF
        bool "Couper les LDO internes de la carte SD et du PHY MIPI avant la veille"
        default y
        help
            ESP-IDF coupe lui-même la flash (VO1) et la PSRAM (VO2) en veille
            profonde, mais pas VO3 (PHY MIPI) ni VO4 (domaine d'E/S de la carte
            SD) : un module qui oublierait de les libérer augmenterait la
            consommation en veille (voir le guide de la P4X). Cette option les
            coupe juste avant la veille (canaux NID_MIPI_LDO_CHAN et
            NID_SD_LDO_CHAN). Les canaux de la flash et de la PSRAM ne sont
            jamais touchés.

    config NID_LATCH_OFF_TIMEOUT_MS
        int "Délai de coupure par l'interrupteur avant repli sur la veille profonde (ms)"
        depends on NID_POWER_LATCH
        range 200 10000
        default 2000
        help
            Architecture « coupure matérielle » : après la commande OFF,
            l'alimentation doit disparaître. Si la carte fonctionne encore après
            ce délai (alimentation USB au banc), elle passe en veille profonde.

endmenu
```

## firmware/main/Kconfig.projbuild
```kconfig
menu "Suivi nid — Application"

    choice NID_RUN_MODE
        prompt "Mode de fonctionnement"
        default NID_MODE_FIELD
        help
            Terrain : veille profonde entre deux événements (autonomie FC3.1).
            Banc d'essai : la carte reste éveillée, la caméra reste initialisée,
            les événements arrivent par interruption ; pratique pour mesurer
            les délais et mettre au point (plan firmware, étape 2).

        config NID_MODE_FIELD
            bool "Terrain : veille profonde entre deux événements"
        config NID_MODE_BENCH
            bool "Banc d'essai : toujours éveillé"
    endchoice

    choice NID_POWER_ARCH
        prompt "Architecture d'alimentation"
        default NID_POWER_DEEP_SLEEP
        help
            Veille profonde : la carte reste alimentée, l'ESP32-P4 dort
            (preuve de concept retenue). Coupure matérielle : interrupteur
            Pololu commandé par le PIR et l'alarme du DS3231 (architecture
            cible « Arch ESP-P4 »), l'ESP32-P4 coupe lui-même son alimentation.

        config NID_POWER_DEEP_SLEEP
            bool "Veille profonde de l'ESP32-P4"
        config NID_POWER_LATCH
            bool "Coupure matérielle (interrupteur Pololu + alarme DS3231)"
    endchoice

    config NID_INSTALL_ON_POWER_ON
        bool "Ouvrir le mode installation à la mise sous tension"
        default y

    config NID_BENCH_SEQ_DURATION_S
        int "Durée de séquence imposée en mode banc (s, 0 = valeur de config.ini)"
        range 0 300
        default 10
        depends on NID_MODE_BENCH

    config NID_WDT_TIMEOUT_S
        int "Délai du chien de garde (s)"
        range 5 120
        default 30
        help
            Une tâche bloquée plus longtemps provoque un redémarrage, puis la
            surveillance reprend seule (FC3.3 : reprise ≤ 5 min).

    config NID_BATT_RECHECK_S
        int "Contrôle de la batterie après arrêt critique (s, 0 = jamais)"
        range 0 86400
        default 21600

    config NID_MAX_CHAINED_SEQUENCES
        int "Séquences enchaînées max. si le PIR reste actif (délai désactivé)"
        range 1 100
        default 10

endmenu
```
